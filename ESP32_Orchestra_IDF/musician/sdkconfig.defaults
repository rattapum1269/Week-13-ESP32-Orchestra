## ESP32_Orchestra_IDF/musician/sdkconfig.defaults
```kconfig
# ESP-IDF configuration defaults for Orchestra Musician

# Enable ESP-NOW
CONFIG_ESP_WIFI_ENABLED=y
CONFIG_ESP_NOW_ENABLE=y

# WiFi Configuration
CONFIG_ESP_WIFI_STATIC_RX_BUFFER_NUM=10
CONFIG_ESP_WIFI_DYNAMIC_RX_BUFFER_NUM=32
CONFIG_ESP_WIFI_TX_BUFFER_TYPE=1
CONFIG_ESP_WIFI_DYNAMIC_TX_BUFFER_NUM=32

# ESP-NOW Configuration
CONFIG_ESP_WIFI_ESP_NOW_MAX_ENCRYPT_NUM=0

# Log level
CONFIG_LOG_DEFAULT_LEVEL_INFO=y
CONFIG_LOG_DEFAULT_LEVEL=3

# FreeRTOS
CONFIG_FREERTOS_HZ=1000

# ESP Timer
CONFIG_ESP_TIMER_TASK_STACK_SIZE=4096

# Main task stack size
CONFIG_ESP_MAIN_TASK_STACK_SIZE=8192

# LEDC (PWM) Configuration
CONFIG_LEDC_USE_REF_TICK=y

# Component config
CONFIG_LWIP_LOCAL_HOSTNAME="orchestra-musician"
```
